/dts-v1/;
/ {
	fragment@0 {
		target-path = "/pwm@ff420000";
		__overlay__ {
			status = "okay";
		};
	};

	fragment@1 {
		target-path = "/lcd-backlight";
		__overlay__ {
			status = "okay";
		};
	};

	fragment@2 {
		target-path = "/dsi@ff960000";
		__overlay__ {
			status = "okay";
		};
	};
};
